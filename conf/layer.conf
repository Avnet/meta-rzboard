## conf/layer.conf
```bitbake
# We have a conf and classes directory, add to BBPATH
BBPATH .= ":${LAYERDIR}"

# We have recipes-* directories, add to BBFILES
BBFILES += "${LAYERDIR}/recipes-*/*/*.bb \
            ${LAYERDIR}/recipes-*/*.bb \
            ${LAYERDIR}/recipes-*/*.bbappend \
            ${LAYERDIR}/recipes-*/*/*.bbappend"

BBFILE_COLLECTIONS += "rzboard"
BBFILE_PATTERN_rzboard = "^${LAYERDIR}/"
BBFILE_PRIORITY_rzboard = "16"

LAYERDEPENDS_rzboard = "rz-common rzv2l"
LAYERSERIES_COMPAT_rzboard = "dunfell"


# Avnet Github Mirror
RZBOARD_GIT_HOST_MIRROR ?= "git://github.com/Avnet"
RZBOARD_GIT_PROTOCOL ?= "protocol=https"
RZBOARD_GIT_USER ?= ""
```

## conf/machine/include/cip-core-extend.inc
```bitbake
GCCVERSION_debian = "${@'9.5.0' if 'Bullseye' in '${CIP_MODE}' else '9.3.0'}"
BINUVERSION_debian = "${@'2.34%' if 'Bullseye' in '${CIP_MODE}' else '2.31.%'}"
PREFERRED_VERSION_gdb_debian = "${@'9.1' if 'Bullseye' in '${CIP_MODE}' else '8.1'}"

PREFERRED_PROVIDER_virtual/crypt ?= "glibc"
PREFERRED_PROVIDER_virtual/nativesdk-crypt ?= "nativesdk-glibc"
PREFERRED_PROVIDER_virtual/lib32-crypt ?= "lib32-glibc"
```

## conf/machine/rzboard.conf
```bitbake
#@TYPE: Machine
#@NAME: Avnet RzBoard machine
#@SOC:  RZ/V2L
#@DESCRIPTION: RZ/V2L SMARC platform

OVERRIDES_append = ":rzboard"

SOC_FAMILY = "r9a07g054l"
require conf/machine/include/rzv2l-common.inc
require conf/machine/include/cip-core.inc
require conf/machine/include/cip-core-extend.inc

DEFAULTTUNE ?= "cortexa55"

TUNE_CONF ?= "conf/machine/include/tune-cortexa55.inc"
require ${TUNE_CONF}

PREFERRED_PROVIDER_virtual/kernel="linux-renesas"

UBOOT_CONFIG ??= "rzboard"
UBOOT_CONFIG[rzboard] = "rzboard_defconfig"

KERNEL_DEVICETREE = " renesas/rzboard.dtb"
KERNEL_DEVICETREE_OVERLAY_rzboard  = " \
	renesas/overlays/rzboard-adc.dtbo \
	renesas/overlays/rzboard-can.dtbo \
	renesas/overlays/rzboard-cm33.dtbo \
	renesas/overlays/rzboard-hdmi.dtbo \
	renesas/overlays/rzboard-mipi.dtbo \
	renesas/overlays/rzboard-lite-audio.dtbo \
	renesas/overlays/rzboard-ov5640.dtbo \
	renesas/overlays/rzboard-imx219.dtbo \
	renesas/overlays/rzboard-ext-i2c.dtbo \
	renesas/overlays/rzboard-ext-spi.dtbo \
	renesas/overlays/rzboard-ext-uart2.dtbo \
	renesas/overlays/rzboard-mipi-ph720128t003.dtbo \
"

# generate wic image
IMAGE_FSTYPES_append = " wic wic.bz2"
WKS_FILE = "sdimage-rzboard.wks"
IMAGE_BOOT_FILES = " Image rzboard.dtb"

# flash writer
EXTRA_IMAGEDEPENDS += " flash-writer"
EXTRA_IMAGEDEPENDS += " flash-utility"

# Deploy the uEnv.txt to the /boot directory
WKS_FILE_DEPENDS_append = " uenv"
IMAGE_BOOT_FILES += "uEnv.txt"
IMAGE_BOOT_FILES += "readme.txt"

# Support DTB Overlay files
IMAGE_BOOT_FILES += " overlays/*;overlays/"
IMAGE_BOOT_FILES += " cm33/*;cm33/"

# Ship kernel modules
MACHINE_EXTRA_RRECOMMENDS += "kernel-modules"
```
